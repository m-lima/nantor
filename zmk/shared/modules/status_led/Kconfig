## zmk/shared/modules/status_led/Kconfig
```kconfig
DT_COMPAT_ZMK_BEHAVIOR_STATUS_LED := zmk,behavior-status-led

config ZMK_BEHAVIOR_STATUS_LED
  bool
  default $(dt_compat_enabled,$(DT_COMPAT_ZMK_BEHAVIOR_STATUS_LED))

if ZMK_BEHAVIOR_STATUS_LED
menu "Status LED Options"

config ZMK_BEHAVIOR_STATUS_LED_WATCHDOG
  bool "Should blink any moment the connection has dropped"

config ZMK_BEHAVIOR_STATUS_LED_ROLLOVER
  int "Rollover for status LED requests"
  default 2

endmenu
endif # ZMK_BEHAVIOR_STATUS_LED
```

## zmk/shared/modules/status_led/dts/bindings/behaviors/zmk,behavior-status-led.yaml
```yaml
description: Uses LEDs to communicate stateful configurations

compatible: "zmk,behavior-status-led"

include: one_param.yaml

properties:
  led-gpios:
    type: phandle-array
    required: true
```
