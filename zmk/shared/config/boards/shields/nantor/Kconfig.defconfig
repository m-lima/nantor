## zmk/shared/config/boards/shields/nantor/Kconfig.defconfig
```kconfig
if SHIELD_NANTOR_LEFT

config ZMK_KEYBOARD_NAME
  default "Nantor"

config ZMK_SPLIT_ROLE_CENTRAL
  default y

endif

if SHIELD_NANTOR_LEFT || SHIELD_NANTOR_RIGHT

config ZMK_SPLIT
  default y

endif
```

## zmk/shared/config/boards/shields/nantor/Kconfig.shield
```kconfig
config SHIELD_NANTOR_LEFT
  def_bool $(shields_list_contains,nantor_left)

config SHIELD_NANTOR_RIGHT
  def_bool $(shields_list_contains,nantor_right)
```
